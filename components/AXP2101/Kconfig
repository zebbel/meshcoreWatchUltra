## components/AXP2101/Kconfig
```kconfig
menu "MeshcoreWatch Power Management"

    config MCW_POWER_APPLY_CHARGER
        bool "Apply battery charging configuration at startup"
        default n
        help
            Enable writing the selected charger settings to AXP2101.
            Disabled by default for the first hardware test.

    if MCW_POWER_APPLY_CHARGER

        config MCW_POWER_CHARGING_ENABLED
            bool "Enable battery charging"
            default y

        choice
            prompt "Fast charging current"
            default MCW_POWER_FAST_300

            config MCW_POWER_FAST_200
                bool "200 mA"

            config MCW_POWER_FAST_300
                bool "300 mA"

            config MCW_POWER_FAST_400
                bool "400 mA"
        endchoice

        config MCW_POWER_PRECHARGE_MA
            int "Precharge current (mA, steps of 25)"
            range 0 200
            default 125

        config MCW_POWER_TERMINATION_MA
            int "Charge termination current (mA, steps of 25)"
            range 0 200
            default 125

        choice
            prompt "Charging target voltage"
            default MCW_POWER_TARGET_4200

            config MCW_POWER_TARGET_4100
                bool "4100 mV"

            config MCW_POWER_TARGET_4200
                bool "4200 mV"
        endchoice

        choice
            prompt "USB input current limit"
            default MCW_POWER_USB_1500

            config MCW_POWER_USB_500
                bool "500 mA"

            config MCW_POWER_USB_900
                bool "900 mA"

            config MCW_POWER_USB_1500
                bool "1500 mA"
        endchoice

        config MCW_POWER_USB_VOLTAGE_MV
            int "USB input voltage limit (mV, steps of 80)"
            range 3880 5080
            default 4360

    endif
endmenu
```

## components/CO5300/Kconfig
```kconfig
menu "MeshcoreWatch CO5300 Display"

    choice
        prompt "Display QSPI clock"
        default MCW_DISPLAY_SPI_40

        config MCW_DISPLAY_SPI_20
            bool "20 MHz"

        config MCW_DISPLAY_SPI_40
            bool "40 MHz"

        config MCW_DISPLAY_SPI_80
            bool "80 MHz"
    endchoice

    config MCW_DISPLAY_BRIGHTNESS
        int "Initial AMOLED brightness (0-255)"
        range 0 255
        default 128

endmenu
```

## hardware/CO5300/Kconfig
```kconfig
menu "MeshcoreWatch CO5300 Display"

    # Production panel uses validated 40 MHz and 25% initial brightness.

    config MCW_AMOLED_DEEP_STANDBY
        bool "CO5300 AMOLED deep standby when screen is off"
        default y
        help
            Send the CO5300 sleep-in and deep-standby commands when the
            watch screen times out. The driver resets and reinitializes
            the panel on touch wake. ESP32, BLE, LoRa and touch power
            are not turned off. Disable to keep the previous display-off
            behavior if panel wake is unreliable on your board.

endmenu
```

## hardware/SX1262/Kconfig
```kconfig
menu "MeshcoreWatch SX1262 Radio"

    choice
        prompt "SX1262 SPI clock"
        default MCW_SX1262_SPI_4M

        config MCW_SX1262_SPI_4M
            bool "4 MHz"

        config MCW_SX1262_SPI_8M
            bool "8 MHz"
    endchoice

endmenu
```

## main/Kconfig.projbuild
```kconfig
menu "MeshCore Watch power"
    config MCW_AUTO_LIGHT_SLEEP
        bool "Automatic light sleep while display and GPS are idle"
        default y
        help
            Allows ESP-IDF tickless idle to use light sleep when LoRa RX,
            touch IRQ and BLE are available, but screen and GNSS are idle.
            Turn off to retain dynamic frequency scaling without automatic light sleep.

    config MCW_CONNECTED_BLE_LIGHT_SLEEP
        bool "Allow automatic light sleep during idle BLE connections"
        depends on MCW_AUTO_LIGHT_SLEEP
        default y
        help
            Keep an authenticated BLE connection while permitting the ESP32-S3
            to enter automatic light sleep between BLE controller events.
            NimBLE/controller PM locks still protect active radio events.
            If a phone exhibits connection instability, disable this option.
endmenu
```

## services/services/Kconfig
```kconfig
menu "MeshCore Watch motion features"

    config MCW_RAISE_TO_WAKE
        bool "Raise wrist to wake display"
        default y
        help
            Wake the display on a BHI260AP wrist tilt event while the screen is off.
            Enable GPIO8 as an additional EXT1 light-sleep wake source when available.
            Gestures while the display is awake do not extend its inactivity timeout.
            Disabling this option keeps step, wrist and motion sensor processing active.

endmenu
```

## watch/WatchDisplay/Kconfig
```kconfig
menu "meshcoreWatchUltra watch clock"
    config MCW_WATCH_CLOCK_TIMEZONE
        string "Clock page POSIX timezone"
        default "CET-1CEST,M3.5.0,M10.5.0/3"
        help
            POSIX TZ specification used to display the local time. The default
            shows Germany's CET/CEST with automatic daylight-saving changes.
            This affects only local-time formatting; the RTC and GPS store UTC.

    config MCW_WATCH_CLOCK_LARGE_FONT
        bool "Include 48px font for the watch clock"
        default y
        select LV_FONT_MONTSERRAT_48
        select LV_FONT_MONTSERRAT_28
        help
            Include LVGL's built-in Montserrat 48 font for the 2x centered
            time and Montserrat 28 for the battery percentage.
    config MCW_WATCH_CLOCK_STATUS_FONT
        bool "Use 40px font for GPS / MeshCore / BLE status"
        default y
        select LV_FONT_MONTSERRAT_40
        help
            Double status text from 20px to a native 40px font without
            scaling an intermediate rendering layer.

endmenu
```
